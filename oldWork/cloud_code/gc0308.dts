&i2c3{
    clock-frequency = <100000>;
    pinctrl-names = "default";
    pinctrl-0 = <&pinctrl_i2c3_1>;
    status = "okay";

    gc0308: gc0308@21{
        compatible = "gc0308-capture";
        reg = <0x21>;
        pinctrl-names = "default";
        pinctrl-0 = <&pinctrl_ipu1_4>; /*LJH GC0308  camera*/
        clocks = <&clks 201>;
        clock-names = "csi_mclk";
        DOVDD-supply = <&vgen4_reg>; /* 1.8v */
        AVDD-supply = <&vgen3_reg>;  /* 2.8v, on rev C board is VGEN3,
                        on rev B board is VGEN5 */
        DVDD-supply = <&vgen2_reg>;  /* 1.5v*/
        pwn-gpios = <&gpio5 29 1>;   /* active low: SD1_DAT0 */
        rst-gpios = <&gpio5 28 0>;   /* active high: SD1_DAT1 */
        csi_id = <0>;
        mclk = <24000000>;
        mclk_source = <0>;
    };


};

 pinctrl_ipu1_4: ipu1grp-4 { /*++++ LJH GC0308  camera */
            fsl,pins = <
                MX6QDL_PAD_GPIO_3__CCM_CLKO2               0x130b0    /*时钟*/
                /*MX6QDL_PAD_CSI0_DAT10__IPU1_CSI0_DATA10    0x80000000  /*CAM_nRST_CSI0_DAT10*/
                /*MX6QDL_PAD_CSI0_DAT11__IPU1_CSI0_DATA11    0x80000000  /*CAM_SHDN_CSI0_DAT11*/
                MX6QDL_PAD_CSI0_DAT10__GPIO5_IO28          0x80000000  
                MX6QDL_PAD_CSI0_DAT11__GPIO5_IO29          0x80000000 /* DAT11 */ 
                MX6QDL_PAD_CSI0_DAT12__IPU1_CSI0_DATA12    0x80000000  /*12-19八条数据线*/
                MX6QDL_PAD_CSI0_DAT13__IPU1_CSI0_DATA13    0x80000000
                MX6QDL_PAD_CSI0_DAT14__IPU1_CSI0_DATA14    0x80000000
                MX6QDL_PAD_CSI0_DAT15__IPU1_CSI0_DATA15    0x80000000
                MX6QDL_PAD_CSI0_DAT16__IPU1_CSI0_DATA16    0x80000000
                MX6QDL_PAD_CSI0_DAT17__IPU1_CSI0_DATA17    0x80000000
                MX6QDL_PAD_CSI0_DAT18__IPU1_CSI0_DATA18    0x80000000
                MX6QDL_PAD_CSI0_DAT19__IPU1_CSI0_DATA19    0x80000000
                MX6QDL_PAD_CSI0_DATA_EN__IPU1_CSI0_DATA_EN 0x80000000  /* 硬件悬空*/
                MX6QDL_PAD_CSI0_PIXCLK__IPU1_CSI0_PIXCLK   0x80000000   /*像素时钟*/
                MX6QDL_PAD_CSI0_MCLK__IPU1_CSI0_HSYNC      0x80000000
                MX6QDL_PAD_CSI0_VSYNC__IPU1_CSI0_VSYNC     0x80000000
                >;
        };

